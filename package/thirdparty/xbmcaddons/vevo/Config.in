## package/thirdparty/xbmcaddons/vevo/Config.in
```kconfig
config BR2_PACKAGE_XBMC_ADDON_VEVO
    bool "vevo"
    default y
    help
      Xbmc VEVO Addon
```

## package/thirdparty/xbmcaddons/vevotv/Config.in
```kconfig
config BR2_PACKAGE_XBMC_ADDON_VEVOTV
    bool "vevotv"
    default y
    help
      Xbmc VEVO TV Addon
```

## package/thirdparty/xbmcaddons/xbmc_subtitles/Config.in
```kconfig
config BR2_PACKAGE_XBMC_ADDON_XBMC_SUBTITLES
    bool "script.xbmc.subtitles"
    default y
    help
      Xbmc Subtitles Addon
```

## package/thirdparty/xbmcaddons/xbmcbackup/Config.in
```kconfig
config BR2_PACKAGE_XBMC_ADDON_XBMCBACKUP
    bool "script.xbmcbackup"
    default y
    help
      Backup and restore your XBMC database and configuration files in the event of a crash or file corruption.
```

## package/thirdparty/xbmcaddons/xbmcswift2/Config.in
```kconfig
config BR2_PACKAGE_XBMC_ADDON_XBMCSWIFT2
    bool "script.module.xbmcswift2"
    default y
    help
      xbmcswift2 for addon development
```

## package/thirdparty/xbmcaddons/youtube/Config.in
```kconfig
config BR2_PACKAGE_XBMC_ADDON_YOUTUBE
    bool "plugin.video.youtube"
    default y
    help
      Youtube XBMC plugin
```
