## package/thirdparty/boxik/Config.in
```kconfig
config BR2_PACKAGE_BOXIK_SKIN
depends on BR2_PACKAGE_XBMC
        bool "BOXiK Skin"
```

## package/thirdparty/xbmcaddons/Config.in
```kconfig
menu "XBMC addons"
    depends on BR2_PACKAGE_XBMC

comment "XBMC services"

source "package/thirdparty/xbmcaddons/opensubtitles/Config.in"
source "package/thirdparty/xbmcaddons/skinwidgets/Config.in"
source "package/thirdparty/xbmcaddons/weather_underground/Config.in"

comment "XBMC scripts"
source "package/thirdparty/xbmcaddons/chorus/Config.in"
source "package/thirdparty/xbmcaddons/help/Config.in"
source "package/thirdparty/xbmcaddons/radio/Config.in"
source "package/thirdparty/xbmcaddons/fanart/Config.in"
source "package/thirdparty/xbmcaddons/cinex/Config.in"
source "package/thirdparty/xbmcaddons/parsedom/Config.in"
source "package/thirdparty/xbmcaddons/nm/Config.in"
source "package/thirdparty/xbmcaddons/boxik_service/Config.in"
source "package/thirdparty/xbmcaddons/xbmc_subtitles/Config.in"
source "package/thirdparty/xbmcaddons/hdtrailers_net/Config.in"
source "package/thirdparty/xbmcaddons/artistslideshow/Config.in"
source "package/thirdparty/xbmcaddons/artwork/Config.in"
source "package/thirdparty/xbmcaddons/plugincache/Config.in"
source "package/thirdparty/xbmcaddons/favourites/Config.in"
source "package/thirdparty/xbmcaddons/globalsearch/Config.in"
source "package/thirdparty/xbmcaddons/libraryeditor/Config.in"
source "package/thirdparty/xbmcaddons/beautifulsoup/Config.in"
source "package/thirdparty/xbmcaddons/elementtree/Config.in"
source "package/thirdparty/xbmcaddons/mechanize/Config.in"
source "package/thirdparty/xbmcaddons/requests/Config.in"
source "package/thirdparty/xbmcaddons/requests2/Config.in"
source "package/thirdparty/xbmcaddons/simple_downloader/Config.in"
source "package/thirdparty/xbmcaddons/simplejson/Config.in"
source "package/thirdparty/xbmcaddons/xbmcswift2/Config.in"
source "package/thirdparty/xbmcaddons/playalbum/Config.in"
source "package/thirdparty/xbmcaddons/nextaired/Config.in"
source "package/thirdparty/xbmcaddons/tvtunes/Config.in"
source "package/thirdparty/xbmcaddons/debuglog/Config.in"
source "package/thirdparty/xbmcaddons/xbmcbackup/Config.in"
source "package/thirdparty/xbmcaddons/youtube/Config.in"
source "package/thirdparty/xbmcaddons/vevo/Config.in"
source "package/thirdparty/xbmcaddons/vevotv/Config.in"
endmenu
```

## package/thirdparty/xbmcaddons/artistslideshow/Config.in
```kconfig
config BR2_PACKAGE_XBMC_ADDON_ARTISTSLIDESHOW
    bool "script.artistslideshow"
    default y
    help
      Xbmc script.artistslideshow
```

## package/thirdparty/xbmcaddons/artwork/Config.in
```kconfig
config BR2_PACKAGE_XBMC_ADDON_ARTWORK
    bool "script.artwork.downloader"
    default y
    help
      Xbmc Artwork downloader
```

## package/thirdparty/xbmcaddons/beautifulsoup/Config.in
```kconfig
config BR2_PACKAGE_XBMC_ADDON_BEAUTIFULSOUP
    bool "script.module.beautifulsoup"
    default y
    help
      HTML/XML parser for quick-turnaround applications like screen-scraping
```

## package/thirdparty/xbmcaddons/boxik_service/Config.in
```kconfig
config BR2_PACKAGE_XBMC_ADDON_BOXIK_SERVICE
    bool "boxik_service"
    default y 
    help
      Xbmc BOXiK Service Addon
```

## package/thirdparty/xbmcaddons/chorus/Config.in
```kconfig
config BR2_PACKAGE_XBMC_ADDON_CHORUS
    bool "webinterface.chorus"
    default y
    help
      Xbmc Chorus web interface addon
```

## package/thirdparty/xbmcaddons/cinex/Config.in
```kconfig
config BR2_PACKAGE_XBMC_ADDON_CINEX
    bool "script.cinema.experience"
    default y
    help
      script.cinema.experience
```

## package/thirdparty/xbmcaddons/debuglog/Config.in
```kconfig
config BR2_PACKAGE_XBMC_ADDON_DEBUGLOG
    bool "script.xbmc.debug.log"
    default y
    help
      Uploads your logs to xbmclogs.com
```

## package/thirdparty/xbmcaddons/elementtree/Config.in
```kconfig
config BR2_PACKAGE_XBMC_ADDON_ELEMENTTREE
    bool "script.module.elementtree"
    default y
    help
      Elementtree XML parser
```

## package/thirdparty/xbmcaddons/fanart/Config.in
```kconfig
config BR2_PACKAGE_XBMC_ADDON_FANART
    bool "service.skin.fanart"
    default y
    help
      Xbmc Fanart addon
```

## package/thirdparty/xbmcaddons/hdtrailers_net/Config.in
```kconfig
config BR2_PACKAGE_XBMC_ADDON_HDTRAILERS_NET
    bool "plugin.video.hdtrailers_net"
    default y
    help
      Trailer and Clips from several sources in HD
```

## package/thirdparty/xbmcaddons/help/Config.in
```kconfig
config BR2_PACKAGE_XBMC_ADDON_HELP
    bool "plugin.video.boxik.channel"
    default y
    help
      Boxik Help Channel
```

## package/thirdparty/xbmcaddons/nextaired/Config.in
```kconfig
config BR2_PACKAGE_XBMC_ADDON_NEXTAIRED
    bool "script.tv.show.next.aired"
    default y
    help
      Get info for TV Shows Next Aired.
```

## package/thirdparty/xbmcaddons/nm/Config.in
```kconfig
config BR2_PACKAGE_XBMC_ADDON_NM
    bool "nm"
    default y
    help
      Xbmc NetworkManager Addon
```

## package/thirdparty/xbmcaddons/parsedom/Config.in
```kconfig
config BR2_PACKAGE_XBMC_ADDON_PARSEDOM
    bool "script.module.PARSEDOM"
    default y
    help
      script.module.parsedom
```

## package/thirdparty/xbmcaddons/playalbum/Config.in
```kconfig
config BR2_PACKAGE_XBMC_ADDON_PLAYALBUM
    bool "script.playalbum"
    default y
    help
      Script will play a full album when executed in the album info dialog.
```

## package/thirdparty/xbmcaddons/plugincache/Config.in
```kconfig
config BR2_PACKAGE_XBMC_ADDON_PLUGINCACHE
    bool "script.common.plugin.cache"
    default y
    help
      Common caching api for xbmc plugins
```

## package/thirdparty/xbmcaddons/radio/Config.in
```kconfig
config BR2_PACKAGE_XBMC_ADDON_RADIO
    bool "plugin.audio.radio_de"
    default y
    help
      Xbmc plugin.audio.radio_de
```

## package/thirdparty/xbmcaddons/requests/Config.in
```kconfig
config BR2_PACKAGE_XBMC_ADDON_REQUESTS
    bool "script.module.requests"
    default y
    help
      Python HTTP for Humans
```

## package/thirdparty/xbmcaddons/requests2/Config.in
```kconfig
config BR2_PACKAGE_XBMC_ADDON_REQUESTS2
    bool "script.module.requests2"
    default y
    help
      Python HTTP for Humans
```

## package/thirdparty/xbmcaddons/simple_downloader/Config.in
```kconfig
config BR2_PACKAGE_XBMC_ADDON_SIMPLE_DOWNLOADER
    bool "script.module.simple.downloader"
    default y
    help
      Simple downloader for xbmc plugins.
```

## package/thirdparty/xbmcaddons/simplejson/Config.in
```kconfig
config BR2_PACKAGE_XBMC_ADDON_SIMPLEJSON
    bool "script.module.simplejson"
    default y
    help
      Xbmc script.module.simplejson
```

## package/thirdparty/xbmcaddons/skinwidgets/Config.in
```kconfig
config BR2_PACKAGE_XBMC_ADDON_SKINWIDGETS
    bool "service.skin.widgets"
    default y
    help
      Xbmc service.skin.widgets
```

## package/thirdparty/xbmcaddons/tvtunes/Config.in
```kconfig
config BR2_PACKAGE_XBMC_ADDON_TVTUNES
    bool "script.tvtunes"
    default y
    help
      Get and play your Movie and TV shows Themes
```
